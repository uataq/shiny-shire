/*************************************
Generated by EZMet
http://air.utah.edu/s/ezmet/
Ben Fasoli

Adafruit GPS Breakout
Wiring Info (SPI):
VIN : 5V
GND : GND
RX  : 2
TX  : 3

AM2315
Wiring Info (I2C):
10k resistor between 5V and SDA/SCL
Red : 5V
Blk : GND
Ylw : A4
Wht : A5

Column Names:
dht_temp_c, dht_rh_pct, am_temp_c, am_rh_pct
*************************************/

// Libraries
#include "SD.h"
#include "Adafruit_GPS.h"
#include "SoftwareSerial.h"
#include "Adafruit_AM2315.h"

// Constants
int interval = 1000;
SoftwareSerial gpsSerial(3, 2);
Adafruit_GPS GPS(&gpsSerial);
Adafruit_AM2315 am;

// Program Setup
void setup() {
Serial.begin(9600);
Serial.println("Generated by EZMet");
Serial.println("http://air.utah.edu/s/ezmet/");
Serial.println("Ben Fasoli");

Serial.println();
SD.begin(4);
GPS.begin(9600);
GPS.sendCommand(PMTK_SET_NMEA_OUTPUT_RMCGGA);
GPS.sendCommand(PMTK_SET_NMEA_UPDATE_1HZ);
am.begin();
}

// Program Loop
void loop() {
File file = SD.open("raw.dat", FILE_WRITE);
if (file) {
if (GPS.fix) {
Serial.print(GPS.year); Serial.print("-");
Serial.print(GPS.month); Serial.print("-");
Serial.print(GPS.day); Serial.print(" ");
Serial.print(GPS.hour); Serial.print(":");
Serial.print(GPS.minute); Serial.print(":");
Serial.print(GPS.seconds); Serial.print(".");
Serial.print(GPS.milliseconds); Serial.print(",");
Serial.print(GPS.latitude); Serial.print(",");
Serial.print(GPS.longitude); Serial.print(",");
Serial.print(GPS.altitude); Serial.print(",");
Serial.print(GPS.satellites); Serial.print(",");
file.print(GPS.year); file.print("-");
file.print(GPS.month); file.print("-");
file.print(GPS.day); file.print(" ");
file.print(GPS.hour); file.print(":");
file.print(GPS.minute); file.print(":");
file.print(GPS.seconds); file.print(".");
file.print(GPS.milliseconds); file.print(",");
file.print(GPS.latitude); file.print(",");
file.print(GPS.longitude); file.print(",");
file.print(GPS.altitude); file.print(",");
file.print(GPS.satellites); file.print(",");
} else {
Serial.print(-9999.0); Serial.print(",");
Serial.print(-9999.0); Serial.print(",");
Serial.print(-9999.0); Serial.print(",");
Serial.print(-9999.0); Serial.print(",");
Serial.print(-9999.0); Serial.print(",");
file.print(-9999.0); file.print(",");
file.print(-9999.0); file.print(",");
file.print(-9999.0); file.print(",");
file.print(-9999.0); file.print(",");
file.print(-9999.0); file.print(",");
}
float am_temp_c  = am.readTemperature();
float am_rh_pct  = am.readHumidity();
if (am_temp_c < -30.0 | am_temp_c > 100.0 | isnan(am_temp_c)) {
am_temp_c = -9999.0;
am_rh_pct  = -9999.0;
}
Serial.print(am_temp_c); Serial.print(",");
Serial.print(am_rh_pct); Serial.print(",");
file.print(am_temp_c); file.print(",");
file.print(am_rh_pct); file.print(",");
file.println();
Serial.println();
} else {
Serial.println("ERROR: Could not open SD card file.");
}
delay(interval);
}
