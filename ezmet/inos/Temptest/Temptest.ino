/*************************************
Generated by EZMet
http://air.utah.edu/s/ezmet/
Ben Fasoli

BMP180
Wiring Info (I2C):
VCC : 5V
GND : GND
SDA : A4
SCL : A5

DHT22
Wiring Info (pins left to right):
10k pullup resistor between 5V and data
1 (VCC)  : 5V
2 (Data) : 2
3 : No connection
4 (GND)  : GND

Column Names:
bmp_pres_hpa, bmp_temp_c, dht_temp_c, dht_rh_pct
*************************************/

// Libraries
#include "SD.h"
#include "Adafruit_BMP085.h"
#include "dht.h"

// Constants
int interval = 1000;
Adafruit_BMP085 bmp;
dht DHT;
const int dhtPin = 2;

// Program Setup
void setup() {
Serial.begin(9600);
Serial.println("Generated by EZMet");
Serial.println("http://air.utah.edu/s/ezmet/");
Serial.println("Ben Fasoli");

Serial.println();
SD.begin(4);
bmp.begin();

}

// Program Loop
void loop() {
File file = SD.open("raw.dat", FILE_WRITE);
if (file) {
float bmp_pres_hpa = bmp.readPressure() / 100.0;
float bmp_temp_c  = bmp.readTemperature();
if (bmp_pres_hpa < 300.0 | bmp_pres_hpa > 1100.0) {
bmp_pres_hpa = -9999.0;
bmp_temp_c  = -9999.0;
}
Serial.print(bmp_pres_hpa); Serial.print(",");
Serial.print(bmp_temp_c); Serial.print(",");
file.print(bmp_pres_hpa); file.print(",");
file.print(bmp_temp_c); file.print(",");
int dht_chk  = DHT.read22(dhtPin);
if (dht_chk == 0) {
float dht_temp_c = DHT.temperature;
float dht_rh_pct = DHT.humidity;
Serial.print(dht_temp_c); Serial.print(",");
Serial.print(dht_rh_pct); Serial.print(",");
file.print(dht_temp_c); file.print(",");
file.print(dht_rh_pct); file.print(",");
} else {
Serial.print(-9999.0); Serial.print(",");
Serial.print(-9999.0); Serial.print(",");
file.print(-9999.0); file.print(",");
file.print(-9999.0); file.print(",");
}
file.println();
Serial.println();
} else {
Serial.println("ERROR: Could not open SD card file.");
}
delay(interval);
}
